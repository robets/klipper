## src/atsamc/Kconfig
```kconfig
# Kconfig settings for Atmel SAM C21 processors

if MACH_ATSAMC

config ATSAMC_SELECT
    bool
    default y
    select HAVE_GPIO
    select HAVE_GPIO_ADC
    select HAVE_GPIO_I2C
    select HAVE_GPIO_SPI
    select HAVE_GPIO_HARD_PWM if MACH_SAMC21
    select HAVE_GPIO_BITBANGING
    select HAVE_STRICT_TIMING
    select HAVE_CHIPID
    select HAVE_SAMC_MCAN

config HAVE_SERCOM
    depends on HAVE_GPIO_I2C || HAVE_GPIO_SPI
    bool
    default y

config HAVE_SAMC_MCAN
    bool
    default y if MACH_ATSAMC

config BOARD_DIRECTORY
    string
    default "atsamc"

choice
    prompt "Processor model"
    config MACH_SAMC21G18
        bool "SAMC21G18"
        select MACH_SAMC21
    config MACH_SAMC21E18
        bool "SAMC21E18"
        select MACH_SAMC21
endchoice

config MACH_SAMC21
    bool

config MCU
    string
    default "samc21g18a" if MACH_SAMC21G18
    default "samc21e18a" if MACH_SAMC21E18

config FLASH_SIZE
    hex
    default 0x40000 if MACH_SAMC21G18 || MACH_SAMC21E18

config RAM_START
    hex
    default 0x20000000

config RAM_SIZE
    hex
    default 0x8000 if MACH_SAMC21G18 || MACH_SAMC21E18

config STACK_SIZE
    int
    default 512

choice
    prompt "Clock Reference"
    config SAMC21_CLOCK_REF_X32K
        bool "32.768Khz crystal"
    config SAMC21_CLOCK_REF_X25M
        bool "25Mhz crystal"
    config SAMC21_CLOCK_REF_INTERNAL
        bool "Internal clock"
endchoice

config CLOCK_FREQ
    int
    default 48000000 if MACH_SAMD21

config FLASH_START
    hex
    default 0x0000

config SERIAL
    bool
config CANSERIAL
    bool
choice
    prompt "Communication interface"
    config ATSAMC_SERIAL
        bool "Serial"
        select SERIAL
    config ATSAMC_CANBUS
        bool "CAN Bus"
        select CANSERIAL
endchoice

config CANBUS_FREQUENCY
    int "CAN bus speed" if LOW_LEVEL_OPTIONS && CANSERIAL
    default 500000

endif
```
